## boards/shields/charybdis/Kconfig.defconfig
```kconfig
if SHIELD_CHARYBDIS_CENTRAL_DONGLE

config ZMK_KEYBOARD_NAME
    default "Charybdis"

config ZMK_SPLIT_ROLE_CENTRAL
    default y

endif

if SHIELD_CHARYBDIS_CENTRAL_DONGLE || SHIELD_CHARYBDIS_PERIPHERAL_LEFT || SHIELD_CHARYBDIS_PERIPHERAL_RIGHT

config ZMK_SPLIT
    default y

endif
```
